/dts-v1/;
/plugin/;

/*
 * pru_p9_29.dts  --  (RETIRED) mux header pin P9_29 to PRU0 (mode 4).
 *
 * STATUS: THIS OVERLAY DOES NOT WORK ON 6.12.28-bone25 (or any 6.x BBB image
 * tried). It is kept only as a historical record. DO NOT load it.
 *
 * HARD-WON FACTS (see PRU_SERVO_DEBUG_LOG.md, board #10..#19):
 *   - On this 6.x BeagleBone image, config-pin, devmem, PRU OCP writes to the
 *     Control Module, ARM /dev/mem writes (devmem2), AND DT overlays are all
 *     UNABLE to set the pad mux:
 *       * devmem2 reports "Written" but readback stays 0x28 (kernel drops it).
 *       * Overlay pins-node shapes (&am33xx_pinmux pinctrl-0, &ocp consumer,
 *         &pruss consumer) all load, appear in /proc/device-tree, the pruss
 *         phandle resolves -- but pinctrl-single logs "no pins entries for
 *         pinmux_pru_p9_29_pins" and the pad stays 0x28. Dynamic-overlay +
 *         pinctrl-single quirk: the injected pin node is never registered in
 *         the driver's pin table at probe time.
 *
 * THE WORKING FIX (board #19, FINAL): set the pad in U-Boot, not in Linux.
 *   U-Boot has raw hardware access; a `mw.l` to the padconf register sticks,
 *   and because no DT group references offset 0x9bc, the kernel never re-touches
 *   the pad, so 0x24 survives into Linux.
 *
 *   Put this ONE line in the BOOT-PARTITION uEnv.txt (mmc1p1, mounted at
 *   /boot/firmware/uEnv.txt) -- U-Boot's `uenvcmd` check reads that file BEFORE
 *   `Running uname_boot`:
 *
 *       uenvcmd=mw.l 0x44E109BC 0x24
 *
 *   (And ensure no `dtb_overlay=pru_p9_29.dtbo` line remains in /boot/uEnv.txt.)
 *
 * P9_29 = ball R28 = gpmc_csn3 = GPIO3_21 = gpiochip3 line 21 = pin 111.
 * Conf register: Control-Module offset 0x9BC (phys 0x44E109BC).
 * Mode 4 => PRU0 r30.1. Register value 0x24 = mode 4, pull-down enabled,
 * input buffer off (output-only).
 *
 * Verify after reboot:
 *   sudo grep 9bc /sys/kernel/debug/pinctrl/44e10800.pinmux-pinctrl-single/pins
 *   -> expect "pin 111 (PIN111) 0:? 44e109bc 00000024 pinctrl-single"
 */

/* Retained for reference only -- NOT applied (it does not work on 6.x). */
&am33xx_pinmux {
	pru_p9_29_pins: pinmux_pru_p9_29_pins {
		pinctrl-single,pins = <
			0x9bc 0x24  /* P9_29 (gpmc_csn3) -> Mode 4 (PRU0 r30.1), pull-down */
		>;
	};
};
